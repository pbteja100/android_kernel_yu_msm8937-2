/*
 * Copyright (c) 2015-2016, The Linux Foundation. All rights reserved.
 *
 * This program is free software; you can redistribute it and/or modify
 * it under the terms of the GNU General Public License version 2 and
 * only version 2 as published by the Free Software Foundation.
 *
 * This program is distributed in the hope that it will be useful,
 * but WITHOUT ANY WARRANTY; without even the implied warranty of
 * MERCHANTABILITY or FITNESS FOR A PARTICULAR PURPOSE.  See the
 * GNU General Public License for more details.
 */

&int_codec {
	/delete-property/ qcom,cdc-us-euro-gpios;
  qcom,msm-spk-ext-pa-mode = <3>;
	qcom,msm-spk-ext-pa = <&tlmm 48 0>;
	qcom,msm-spk-ext-pa-compatible = <&tlmm 89 0>;

  qcom,tinno_mbhc_keycode = <226 115 114 0 0 0 0 0>;
  qcom,tinno_mbhc_btn_high = <110 300 480 500 500>;
  qcom,tinno_mbhc_btn_low = <110 300 480 500 500>;
	qcom,msm-mbhc-hphl-swh = <1>;
	qcom,msm-hs-micbias-type = "internal";
 
	qcom,msm-gpios =
		"pri_i2s",
		"us_eu_gpio",
		"quin_i2s";
	qcom,pinctrl-names =
		"all_off",
		"pri_i2s_act",
		"us_eu_gpio_act",
		"pri_i2s_us_eu_gpio_act",
		"quin_act",
		"quin_pri_i2s_act",
		"quin_us_eu_gpio_act",
		"quin_us_eu_gpio_pri_i2s_act";
	pinctrl-names =
		"all_off",
		"pri_i2s_act",
		"us_eu_gpio_act",
		"pri_i2s_us_eu_gpio_act",
		"quin_act",
		"quin_pri_i2s_act",
		"quin_us_eu_gpio_act",
		"quin_us_eu_gpio_pri_i2s_act";
	pinctrl-0 = <&cdc_pdm_lines_sus
			&cdc_pdm_lines_2_sus &cross_conn_det_sus
			&pri_tlmm_lines_sus &pri_tlmm_ws_sus>;
	pinctrl-1 = <&cdc_pdm_lines_act
			&cdc_pdm_lines_2_act &cross_conn_det_sus
			&pri_tlmm_lines_sus &pri_tlmm_ws_sus>;
	pinctrl-2 = <&cdc_pdm_lines_sus
			&cdc_pdm_lines_2_sus &cross_conn_det_act
			&pri_tlmm_lines_sus &pri_tlmm_ws_sus>;
	pinctrl-3 = <&cdc_pdm_lines_act
			&cdc_pdm_lines_2_act &cross_conn_det_act
			&pri_tlmm_lines_sus &pri_tlmm_ws_sus>;
	pinctrl-4 = <&cdc_pdm_lines_sus
			&cdc_pdm_lines_2_sus &cross_conn_det_sus
			&pri_tlmm_lines_act &pri_tlmm_ws_act>;
	pinctrl-5 = <&cdc_pdm_lines_act
			&cdc_pdm_lines_2_act &cross_conn_det_sus
			&pri_tlmm_lines_act &pri_tlmm_ws_act>;
	pinctrl-6 = <&cdc_pdm_lines_sus
			&cdc_pdm_lines_2_sus &cross_conn_det_act
			&pri_tlmm_lines_act &pri_tlmm_ws_act>;
	pinctrl-7 = <&cdc_pdm_lines_act
			&cdc_pdm_lines_2_act &cross_conn_det_act
			&pri_tlmm_lines_act &pri_tlmm_ws_act>;
};

&ext_codec {
	qcom,hdmi-dba-codec-rx;

	qcom,msm-gpios =
		"quin_i2s",
		"us_eu_gpio";
	qcom,pinctrl-names =
		"all_off",
		"quin_act",
		"us_eu_gpio_act",
		"quin_us_eu_gpio_act";
	pinctrl-names =
		"all_off",
		"quin_act",
		"us_eu_gpio_act",
		"quin_us_eu_gpio_act";
	pinctrl-0 = <&pri_tlmm_lines_sus &pri_tlmm_ws_sus
						&cross_conn_det_sus>;
	pinctrl-1 = <&pri_tlmm_lines_act &pri_tlmm_ws_act
						&cross_conn_det_sus>;
	pinctrl-2 = <&pri_tlmm_lines_sus &pri_tlmm_ws_sus
						&cross_conn_det_act>;
	pinctrl-3 = <&pri_tlmm_lines_act &pri_tlmm_ws_act
						&cross_conn_det_act>;

	asoc-codec = <&stub_codec>, <&hdmi_dba>;
	asoc-codec-names = "msm-stub-codec.1", "msm-hdmi-dba-codec-rx";
};

&wsa881x_i2c_e {
	status = "okay";
};

&wsa881x_i2c_44 {
	status = "okay";
};
