/* Copyright (c) 2015-2017, The Linux Foundation. All rights reserved.
 *
 * This program is free software; you can redistribute it and/or modify
 * it under the terms of the GNU General Public License version 2 and
 * only version 2 as published by the Free Software Foundation.
 *
 * This program is distributed in the hope that it will be useful,
 * but WITHOUT ANY WARRANTY; without even the implied warranty of
 * MERCHANTABILITY or FITNESS FOR A PARTICULAR PURPOSE.  See the
 * GNU General Public License for more details.
 */

#include "dsi-panel-icn9706-720-1440p-video.dtsi"
#include "dsi-panel-ili9881c-720-1440p-video.dtsi"

&mdss_dsi0 {
	/delete-property/ vdd-supply;
};

&soc {
	mdss_dsi: qcom,mdss_dsi@0 {
		mdss_dsi0: qcom,mdss_dsi_ctrl0@1a94000 {
			/delete-property/ vdd-supply;
			qcom,regulator-ldo-mode;
			qcom,platform-regulator-settings = [00 01 01 00
				20 07 00];
		};

		mdss_dsi1: qcom,mdss_dsi_ctrl1@1a96000 {
			/delete-property/ vdd-supply;
		};
	};
};
