/* Copyright (c) 2017, The Linux Foundation. All rights reserved.
 *
 * This program is free software; you can redistribute it and/or modify
 * it under the terms of the GNU General Public License version 2 and
 * only version 2 as published by the Free Software Foundation.
 *
 * This program is distributed in the hope that it will be useful,
 * but WITHOUT ANY WARRANTY; without even the implied warranty of
 * MERCHANTABILITY or FITNESS FOR A PARTICULAR PURPOSE.  See the
 * GNU General Public License for more details.
 */

&mdss_mdp {
	dsi_ili9881c_720_1440p_video: qcom,mdss_dsi_ili9881c_720_1440p_video {
		qcom,mdss-dsi-panel-name =	"ili9881c 720 1440p video mode dsi panel";
		qcom,mdss-dsi-panel-controller = <&mdss_dsi0>;
		qcom,mdss-dsi-panel-destination = "display_1";
		qcom,mdss-dsi-panel-type = "dsi_video_mode";
		qcom,mdss-dsi-panel-framerate = <60>;
		qcom,mdss-dsi-virtual-channel-id = <0>;
		qcom,mdss-dsi-stream = <0>;
		qcom,mdss-dsi-panel-width = <720>;
		qcom,mdss-dsi-panel-height = <1440>;
		qcom,mdss-dsi-h-front-porch = <84>;
		qcom,mdss-dsi-h-back-porch = <84>;
		qcom,mdss-dsi-h-pulse-width = <24>;
		qcom,mdss-dsi-h-sync-skew = <0>;
		qcom,mdss-dsi-v-back-porch = <20>;
		qcom,mdss-dsi-v-front-porch = <24>;
		qcom,mdss-dsi-v-pulse-width = <8>;
		qcom,mdss-dsi-h-left-border = <0>;
		qcom,mdss-dsi-h-right-border = <0>;
		qcom,mdss-dsi-v-top-border = <0>;
		qcom,mdss-dsi-v-bottom-border = <0>;
		qcom,mdss-dsi-bpp = <24>;
		qcom,mdss-dsi-underflow-color = <0xff>;
		qcom,mdss-dsi-border-color = <0>;
		qcom,mdss-dsi-h-sync-pulse = <1>;
		qcom,mdss-dsi-traffic-mode = "burst_mode";
		qcom,mdss-dsi-bllp-eof-power-mode;
		qcom,mdss-dsi-bllp-power-mode;
		qcom,mdss-dsi-lane-map = "lane_map_0123";
		qcom,mdss-dsi-lane-0-state;
		qcom,mdss-dsi-lane-1-state;
		qcom,mdss-dsi-lane-2-state;
		qcom,mdss-dsi-lane-3-state;
		qcom,mdss-dsi-panel-timings = [8b 1e 14 00 44 48 18 22 19
						03 04 00];
		qcom,mdss-dsi-t-clk-post = <0x04>;
		qcom,mdss-dsi-t-clk-pre = <0x1c>;
		qcom,mdss-dsi-bl-min-level = <1>;
		qcom,mdss-dsi-bl-max-level = <4095>;
		qcom,mdss-dsi-dma-trigger = "trigger_sw";
		qcom,mdss-dsi-mdp-trigger = "none";
		qcom,mdss-dsi-on-command = [
		39 01 00 00 00 00 04 ff 98 81
		03 39 01 00 00 00 00 02 01 00
		39 01 00 00 00 00 02 02 00 39
		01 00 00 00 00 02 03 73 39 01
		00 00 00 00 02 04 73 39 01 00
		00 00 00 02 05 00 39 01 00
		00 00 00 02 06 06 39 01 00 00
		00 00 02 07 02 39 01 00 00 00
		00 02 08 00 39 01 00 00 00 00
		02 09 01 39 01 00 00 00 00 02
		0a 01 39 01 00 00 00 00 02
		0b 01 39 01 00 00 00 00 02 0c
		01 39 01 00 00 00 00 02 0d 01
		39 01 00 00 00 00 02 0e 01 39
		01 00 00 00 00 02 0f 32 39 01
		00 00 00 00 02 10 32 39 01
		00 00 00 00 02 11 00 39 01 00
		00 00 00 02 12 00 39 01 00 00
		00 00 02 13 01 39 01 00 00 00
		00 02 14 00 39 01 00 00 00 00
		02 15 00 39 01 00 00 00 00
		02 16 00 39 01 00 00 00 00 02
		17 00 39 01 00 00 00 00 02 18
		00 39 01 00 00 00 00 02 19 00
		39 01 00 00 00 00 02 1a 00 39
		01 00 00 00 00 02 1b 00 39
		01 00 00 00 00 02 1c 00 39 01
		00 00 00 00 02 1d 00 39 01 00
		00 00 00 02 1e c0 39 01 00 00
		00 00 02 1f 80 39 01 00 00 00
		00 02 20 03 39 01 00 00 00
		00 02 21 04 39 01 00 00 00 00
		02 22 00 39 01 00 00 00 00 02
		23 00 39 01 00 00 00 00 02 24
		00 39 01 00 00 00 00 02 25 00
		39 01 00 00 00 00 02 26 00
		39 01 00 00 00 00 02 27 00 39
		01 00 00 00 00 02 28 33 39 01
		00 00 00 00 02 29 02 39 01 00
		00 00 00 02 2a 00 39 01 00 00
		00 00 02 2b 00 39 01 00 00
		00 00 02 2c 00 39 01 00 00 00
		00 02 2d 00 39 01 00 00 00 00
		02 2e 00 39 01 00 00 00 00 02
		2f 00 39 01 00 00 00 00 02 30
		00 39 01 00 00 00 00 02 31
		00 39 01 00 00 00 00 02 32 00
		39 01 00 00 00 00 02 33 00 39
		01 00 00 00 00 02 34 03 39 01
		00 00 00 00 02 35 00 39 01 00
		00 00 00 02 36 03 39 01 00
		00 00 00 02 37 00 39 01 00 00
		00 00 02 38 00 39 01 00 00 00
		00 02 39 00 39 01 00 00 00 00
		02 3a 00 39 01 00 00 00 00 02
		3b 00 39 01 00 00 00 00 02
		3c 00 39 01 00 00 00 00 02 3d
		00 39 01 00 00 00 00 02 3e 00
		39 01 00 00 00 00 02 3f 00 39
		01 00 00 00 00 02 40 00 39 01
		00 00 00 00 02 41 00 39 01
		00 00 00 00 02 42 00 39 01 00
		00 00 00 02 43 01 39 01 00 00
		00 00 02 44 00 39 01 00 00 00
		00 02 50 01 39 01 00 00 00 00
		02 51 23 39 01 00 00 00 00
		02 52 45 39 01 00 00 00 00 02
		53 67 39 01 00 00 00 00 02 54
		89 39 01 00 00 00 00 02 55 ab
		39 01 00 00 00 00 02 56 01 39
		01 00 00 00 00 02 57 23 39
		01 00 00 00 00 02 58 45 39 01
		00 00 00 00 02 59 67 39 01 00
		00 00 00 02 5a 89 39 01 00 00
		00 00 02 5b ab 39 01 00 00 00
		00 02 5c cd 39 01 00 00 00
		00 02 5d ef 39 01 00 00 00 00
		02 5e 10 39 01 00 00 00 00 02
		5f 09 39 01 00 00 00 00 02 60
		08 39 01 00 00 00 00 02 61 0f
		39 01 00 00 00 00 02 62 0e
		39 01 00 00 00 00 02 63 0d 39
		01 00 00 00 00 02 64 0c 39 01
		00 00 00 00 02 65 02 39 01 00
		00 00 00 02 66 02 39 01 00 00
		00 00 02 67 02 39 01 00 00
		00 00 02 68 02 39 01 00 00 00
		00 02 69 02 39 01 00 00 00 00
		02 6a 02 39 01 00 00 00 00 02
		6b 02 39 01 00 00 00 00 02 6c
		02 39 01 00 00 00 00 02 6d
		02 39 01 00 00 00 00 02 6e 02
		39 01 00 00 00 00 02 6f 02 39
		01 00 00 00 00 02 70 02 39 01
		00 00 00 00 02 71 06 39 01 00
		00 00 00 02 72 07 39 01 00
		00 00 00 02 73 02 39 01 00 00
		00 00 02 74 02 39 01 00 00 00
		00 02 75 06 39 01 00 00 00 00
		02 76 07 39 01 00 00 00 00 02
		77 0e 39 01 00 00 00 00 02
		78 0f 39 01 00 00 00 00 02 79
		0c 39 01 00 00 00 00 02 7a 0d
		39 01 00 00 00 00 02 7b 02 39
		01 00 00 00 00 02 7c 02 39 01
		00 00 00 00 02 7d 02 39 01
		00 00 00 00 02 7e 02 39 01 00
		00 00 00 02 7f 02 39 01 00 00
		00 00 02 80 02 39 01 00 00 00
		00 02 81 02 39 01 00 00 00 00
		02 82 02 39 01 00 00 00 00
		02 83 02 39 01 00 00 00 00 02
		84 02 39 01 00 00 00 00 02 85
		02 39 01 00 00 00 00 02 86 02
		39 01 00 00 00 00 02 87 09 39
		01 00 00 00 00 02 88 08 39
		01 00 00 00 00 02 89 02 39 01
		00 00 00 00 02 8a 02 39 01 00
		00 00 00 04 ff 98 81 04 39 01
		00 00 00 00 02 6c 15 39 01 00
		00 00 00 02 6e 2a 39 01 00
		00 00 00 02 6f 57 39 01 00 00
		00 00 02 3a a4 39 01 00 00 00
		00 02 8d 1a 39 01 00 00 00 00
		02 87 ba 39 01 00 00 00 00 02
		26 76 39 01 00 00 00 00 02
		b2 d1 39 01 00 00 00 00 02 88
		0b 39 01 00 00 00 00 02 3c 81
		39 01 00 00 00 00 04 ff 98 81
		01 39 01 00 00 00 00 02 22 0a
		39 01 00 00 00 00 02 31 00
		39 01 00 00 00 00 02 53 33 39
		01 00 00 00 00 02 55 3d 39 01
		00 00 00 00 02 50 a8 39 01 00
		00 00 00 02 51 a8 39 01 00 00
		00 00 02 60 06 39 01 00 00
		00 00 02 62 20 39 01 00 00 00
		00 02 2e f0 39 01 00 00 00 00
		02 a0 00 39 01 00 00 00 00 02
		a1 21 39 01 00 00 00 00 02 a2
		35 39 01 00 00 00 00 02 a3
		19 39 01 00 00 00 00 02 a4 1e
		39 01 00 00 00 00 02 a5 33 39
		01 00 00 00 00 02 a6 27 39 01
		00 00 00 00 02 a7 26 39 01 00
		00 00 00 02 a8 af 39 01 00
		00 00 00 02 a9 1b 39 01 00 00
		00 00 02 aa 27 39 01 00 00 00
		00 02 ab 8d 39 01 00 00 00 00
		02 ac 1a 39 01 00 00 00 00 02
		ad 1b 39 01 00 00 00 00 02
		ae 50 39 01 00 00 00 00 02 af
		26 39 01 00 00 00 00 02 b0 2b
		39 01 00 00 00 00 02 b1 54 39
		01 00 00 00 00 02 b2 5e 39 01
		00 00 00 00 02 b3 23 39 01
		00 00 00 00 02 c0 00 39 01 00
		00 00 00 02 c1 21 39 01 00 00
		00 00 02 c2 35 39 01 00 00 00
		00 02 c3 19 39 01 00 00 00 00
		02 c4 1e 39 01 00 00 00 00
		02 c5 33 39 01 00 00 00 00 02
		c6 27 39 01 00 00 00 00 02 c7
		26 39 01 00 00 00 00 02 c8 af
		39 01 00 00 00 00 02 c9 1b 39
		01 00 00 00 00 02 ca 27 39
		01 00 00 00 00 02 cb 8d 39 01
		00 00 00 00 02 cc 1a 39 01 00
		00 00 00 02 cd 1b 39 01 00 00
		00 00 02 ce 50 39 01 00 00 00
		00 02 cf 26 39 01 00 00 00
		00 02 d0 2b 39 01 00 00 00 00
		02 d1 54 39 01 00 00 00 00 02
		d2 5e 39 01 00 00 00 00 02 d3
		23 39 01 00 00 00 00 04 ff 98
		81 00 39 01 00 00 00 00 02
		35 00 05 01 00 00 64 00 02 11
		00 05 01 00 00 0a 00 02 29 00];

		qcom,mdss-dsi-off-command = [
		39 01 00 00 04 ff 98 81 01 39 01 00 00 00 02 b3
		3f 39 01 00 00 02 d3 3f 39 01 00 04 ff 98 81 04
		39 01 00 00 02 2d 02 39 01 00 64 00 02 2f 01 39
		01 00 02 2f 00 39 01 00 00 00 04 ff 98 81 00 05
		01 0a 00 02 28 00 05 01 00 00 78 02 10 00 39 01
		00 00 04 ff 98 81 00 39 01 00 00 00 02 58 01 ];
		qcom,mdss-dsi-on-command-state = "dsi_lp_mode";
		qcom,mdss-dsi-off-command-state = "dsi_lp_mode";
		qcom,esd-check-enabled;
		qcom,mdss-dsi-panel-status-check-mode = "bta_check";
		qcom,mdss-dsi-bl-pmic-control-type = "bl_ctrl_wled";
		qcom,mdss-dsi-reset-sequence = <1 2>, <0 20>, <1 50>;
		qcom,mdss-dsi-tx-eot-append;
		qcom,mdss-pan-physical-width-dimension = <63>;
		qcom,mdss-pan-physical-height-dimension = <112>;
	};
};
