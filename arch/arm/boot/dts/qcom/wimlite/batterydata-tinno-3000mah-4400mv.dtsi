
qcom,tinno-3000mah {
	/* #2785615_Tinno_P6901ACatl_3000mAh_averaged_MasterSlave_Feb13th2017*/
	qcom,max-voltage-uv = <4400000>;
	qcom,nom-batt-capacity-mah = <3000>;
	qcom,batt-id-kohm = <100>;
	qcom,battery-beta = <3435>;
	qcom,battery-type = "tinno-3000mah";
	qcom,chg-rslow-comp-c1 = <2934135>;
	qcom,chg-rslow-comp-c2 = <3638873>;
	qcom,chg-rs-to-rslow = <1012707>;
	qcom,chg-rslow-comp-thr = <0x99>;
	qcom,checksum = <0x1781>;
	qcom,gui-version = "PMI8950GUI - 2.0.0.16";
	qcom,fg-profile-data = [
		 E3 83 DA 7C 
		 05 81 FF 76 
		 5D 83 60 6C 
		 30 88 45 8F 
		 7D 82 E3 92 
		 84 B4 F6 BB 
		 52 16 F1 83 
		 E9 7C F1 80 
		 A7 76 58 83 
		 51 62 D6 80 
		 76 8D 54 82 
		 71 99 A7 BC 
		 63 C9 55 0E 
		 44 0C 03 5A 
		 14 70 B2 FD 
		 2E 3E B1 3F 
		 C6 3A 00 00 
		 66 47 AF 33 
		 8E 32 00 00 
		 00 00 00 00 
		 00 00 00 00 
		 F1 6B EE 6A 
		 2E 72 48 88 
		 C6 6E B8 61 
		 77 60 0E 7B 
		 E7 6D 1E 61 
		 8D 6C CE A1 
		 17 B9 61 BB 
		 5E A0 71 0C 
		 28 00 FF 36 
		 F0 11 30 03 
		 00 00 00 0C 
	];
};
