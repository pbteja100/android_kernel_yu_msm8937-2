## drivers/input/fingerprint/Kconfig
```kconfig
#
# fingerprint driver configuration
#

config INPUT_FINGERPRINT
  bool INPUT_FINGERPRINT
  default n
  help
    Switch for tinno fingerprint

config FINGERPRINT_GOODIX_GF32X8_QSEE
  bool FINGERPRINT_GOODIX_GF32X8_QSEE
  default n
  help
    Goodix Fingerprint chip GF316M/GF318M/GF3118M/GF518M/GF5118M/GF516M/GF816M/GF3208/GF3206/GF3266/GF3288/GF5206/GF5216/GF5208 TEE driver

config FINGERPRINT_GOODIX_GF316M
  bool FINGERPRINT_GOODIX_GF316M
  default n
  help
    Goodix Fingerprint chip GF316M Driver

config FINGERPRINT_ELAN_96SA_QSEE
  bool FINGERPRINT_ELAN_96SA_QSEE
  default n
  help
    elan Fingerprint chip 96sa/80sa for QSEE

config FINGERPRINT_ELAN_519C_QSEE
  bool FINGERPRINT_ELAN_519C_QSEE
  default n
  help
    elan Fingerprint chip 519c for QSEE

config FINGERPRINT_SILEAD_6163_QSEE
  bool FINGERPRINT_SILEAD_6163_QSEE
  default n
  help
    silead Fingerprint chip 6163 for QSEE

config FINGERPRINT_CHIPONE_7152_QSEE
  bool FINGERPRINT_CHIPONE_7152_QSEE
  default n
  help
    chipone Fingerprint chip 7152 for QSEE
```

## drivers/input/touchscreen/focaltech_touch/Kconfig
```kconfig
#
# Focaltech Touchscreen driver configuration
#

config TOUCHSCREEN_FTS
        bool "Focaltech Touchscreen"
		depends on I2C
		default n
		help
		  Say Y here if you have Focaltech touch panel.
		  If unsure, say N.

config FTS_IC_TYPE_3X27
        bool "Use Focaltech IC type"
		depends on TOUCHSCREEN_FTS
		default n
		help
		  Say Y here if you have ft3x27 touch panel.
		  If unsure, say N.

config TOUCHSCREEN_FTS_DIRECTORY
    string "Focaltech ts directory name"
    default "focaltech_touch"
    depends on TOUCHSCREEN_FTS
```

## sound/soc/codecs/tfa/Kconfig
```kconfig
# NXP Smart Audio tfa98xx kernel driver
# Needed I2C and I2S bus support.

#config SND_SOC_TFA98XX
config SND_SOC_TFA9890
	tristate "Build NXP TFA98XX ASoC CODEC drivers"
	depends on I2C
	help
	NXP Smart Audio tfa98xx kernel driver
```
